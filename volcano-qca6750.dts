/dts-v1/;
/plugin/;

#include "volcano-qca6750.dtsi"

/ {
	model = "Qualcomm Technologies, Inc. Volcano SoC";
	compatible = "qcom,volcano";
	qcom,msm-id = <636 0x10000>, <640 0x10000>;
	qcom,board-id = <0 0>;
};
