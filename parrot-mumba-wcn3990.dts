/dts-v1/;
/plugin/;

#include "parrot-wcn3990.dtsi"

/ {
	model = "mumba";
	compatible = "qcom,parrot", "qcom,parrot-qrd", "qcom,qrd", "moto,mumba";
	qcom,msm-id = <663 0x10000>, <715 0x10000>;
	qcom,board-id = <0x41 0x9000>;
};
